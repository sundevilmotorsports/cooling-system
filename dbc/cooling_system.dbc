VERSION ""

NS_ :

BS_:

BU_: SENSOR_NODE LOGGER

BO_ 256 FLOW1: 8 SENSOR_NODE
 SG_ rate_lpm_1 : 0|16@0+ (0.01,0) [0|300] "L/min" LOGGER
 SG_ total_volume_l_1 : 16|32@0+ (0.001,0) [0|4294967.295] "L" LOGGER

BO_ 257 FLOW2: 8 SENSOR_NODE
 SG_ rate_lpm_2 : 0|16@0+ (0.01,0) [0|300] "L/min" LOGGER
 SG_ total_volume_l_2 : 16|32@0+ (0.001,0) [0|4294967.295] "L" LOGGER

CM_ "Local DBC for cooling_system sensor node only. Temporary - IDs/layout are
placeholders until migrated into the global DBC. See CLAUDE.md.";
CM_ BO_ 256 "Flow channel 1: rate + cumulative total volume.";
CM_ BO_ 257 "Flow channel 2: rate + cumulative total volume.";

BA_DEF_ BO_ "GenMsgCycleTime" INT 0 100000;
BA_DEF_DEF_ "GenMsgCycleTime" 0;
BA_ "GenMsgCycleTime" BO_ 256 100;
BA_ "GenMsgCycleTime" BO_ 257 100;
